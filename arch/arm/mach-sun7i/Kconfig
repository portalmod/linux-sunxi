## arch/arm/mach-sun7i/Kconfig
```kconfig
menu "Allwinner's sun7i options"

config MACH_MODDUO
	bool "MOD Duo Multi-Effects Pedal"
	help
	  Say 'Y' here if you want your kernel to support the
	  MOD Duo Multi-Effects Pedal.

endmenu
```

## sound/soc/sunxi/Kconfig
```kconfig
config SND_SUNXI_SOC_CODEC
	tristate "APB On-Chip sun4i and sun5i Codec"
	default y
	
config SND_MOD_DUO_SUNXI
	tristate "Sound Card for MOD Duo"
	select SND_SOC_CS4245
	default m
	help
	  Say Y or M if you want to add support for the MOD Duo Sound Card.
```
